## com/as.infrastructure/system/kernel/askar/Kconfig
```kconfig
choice
	prompt "Schedule Policy"
	default SCHED_BUBBLE

config SCHED_BUBBLE
	bool "bubble sort scheduler"

config SCHED_FIFO
	bool "fifo scheduler"

config SCHED_LIST
	bool "list scheduler"

endchoice

config PTHREAD
	bool "posix pthreads based on askar OSEK core"
	default y
if PTHREAD
config OS_PTHREAD_PRIORITY
	int "the posix thread priority range"
	default 32

config OS_PTHREAD_NUM
	int "the maxmium number of posix threads can be created"
	default 32

config PTHREAD_SIGNAL
	bool "posix pthreads signal"
	default y

config PTHREAD_CLEANUP
	bool "posix pthreads cleanup feature"
	default y
endif
# diable pthread related types defined by compiler library
config __sigset_t_defined
	int
	default 1

config _BITS_PTHREADTYPES_H
	int
	default 1
```

## com/as.infrastructure/system/kernel/rtthread/menuconfig/Kconfig
```kconfig
config RTT_DIR
    string
    option env="RTT_ROOT"
    default "../../rt-thread"

config ASROOT
    string
    option env="ASROOT"
    default "../../../../../../.."
source "$ASROOT/com/as.infrastructure/system/kernel/rtthread/rt-thread/Kconfig"
source "$ASROOT/com/as.infrastructure/system/kernel/rtthread/menuconfig/aspkgs/Kconfig"

config HAVE_SYS_SELECT_H
    bool "Compiler has sys/select.h"
    default y
```

## com/as.infrastructure/system/kernel/rtthread/menuconfig/aspkgs/Kconfig
```kconfig
menu "as packages config"

if RT_USING_DFS
    config RT_USING_LWEXT4
        bool "Using lwext4 file system"
        default y
        help
            The lwext file system is a light weight ext2/3/4 file system.
endif

endmenu
```

## com/as.infrastructure/system/net/Kconfig
```kconfig
menu "Internet Protocol"
config LWIP
	bool "LWIP"
	depends on LWIP_DRV
	default y

config UIP
	bool "UIP"
	depends on UIP_DRV
	select PROTOTHREAD
	default y

if !RTTHREAD
choice
	prompt "LWIP arch"
	default LWIP_POSIX_ARCH if ARCH_POSIX
	default LWIP_OSEK_ARCH  if !ARCH_POSIX
	depends on LWIP

config LWIP_POSIX_ARCH
	bool "lwip standard porting based on pthread"

config LWIP_OSEK_ARCH
	bool "lwip standard porting based on OSEK"

endchoice
endif

config FTP
	bool "File Transfer Protocol Daemon"
	depends on (LWIP || UIP) && (VFS || RT_USING_DFS)
	default y

endmenu
```

## com/as.tool/Kconfig
```kconfig
menu "automotive software toolchain"

choice
	prompt "base building platform"
	default PLATFORM_MSYS2

config PLATFORM_MINGW
	bool "mingw"

config PLATFORM_MSYS2
	bool "msys2"

config PLATFORM_LINUX
	bool "linux"

endchoice

config MINGW_GCC_PATH
	string "directory path of mingw gcc.exe"
	default "c:/MinGW/bin"
	depends on (PLATFORM_MINGW || PLATFORM_MSYS2)

config MSYS2_GCC_PATH
	string "directory path of msys2 gcc.exe"
	default "c:/msys64/mingw64/bin"
	depends on (PLATFORM_MINGW || PLATFORM_MSYS2)

endmenu
```

## release/ascore/Kconfig
```kconfig
mainmenu "Automotive Software AS Configuration"

config BOARD
    string
    option env="BOARD"
    default "posix"

config ASROOT
    string
    option env="ASROOT"
    default "../.."

source "$ASROOT/com/as.tool/Kconfig"
source "$ASROOT/com/as.application/Kconfig"
source "$ASROOT/com/as.infrastructure/Kconfig"
source "SgDesign/Kconfig"
source "elf/Kconfig"
```

## release/ascore/SgDesign/Kconfig
```kconfig
choice
	prompt "SG demo application"
	default SG_DEMO_CLUSTER if ARCH_POSIX
	default SG_DEMO_WATCH if !ARCH_POSIX
	depends on SG

config SG_DEMO_CLUSTER
	bool "automative virtual instrument cluster"

config SG_DEMO_WATCH
	bool "a sample watch"

endchoice
```

## release/ascore/elf/Kconfig
```kconfig
menu "elf application config"

config DLL_FREERTOS
	bool "freertos posix arch port sample"
	depends on PTHREAD_SIGNAL
	default y

endmenu
```

## release/aslinux/meta-as/conf/layer.conf
```bitbake
# We have a conf and classes directory, add to BBPATH
BBPATH .= ":${LAYERDIR}"

# We have recipes-* directories, add to BBFILES
BBFILES += "${LAYERDIR}/recipes-*/*/*.bb ${LAYERDIR}/recipes-*/*/*.bbappend"

BBFILE_COLLECTIONS += "as"
BBFILE_PATTERN_as = "^${LAYERDIR}/"
BBFILE_PRIORITY_as = "1"

# This should only be incremented on significant changes that will
# cause compatibility issues with other layers
LAYERVERSION_as = "1"

LAYERDEPENDS_as = "core"
```
