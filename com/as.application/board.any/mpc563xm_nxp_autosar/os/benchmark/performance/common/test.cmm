; **************************************************************************
;
;  Freescale(TM) and the Freescale logo are trademarks of Freescale Semiconductor, Inc.         
;  All other product or service names are the property of their respective owners.         
;  (C) Freescale Semiconductor, Inc. 2008-2010
;
;  You can use this example for any purpose on any computer system with the
;  following restrictions:
;
;  1. This example is provided "as is", without warranty.
;
;  2. You don't ;ove this copyright notice from this example or any direct
;    derivation thereof.
;
;   Description: It is common part of lauterbach script for each test 
;
; **************************************************************************

GLOBAL &def_suff
ENTRY &CLASS &SC

&suff="_gh"

IF ("&def_suff"!="")
    &suff="&def_suff"

&elf="bin/p&CLASS&SC&suff.elf"
&log="bin/p&CLASS&SC&suff.log"

TITLE "Performance test for &SC/&CLASS"
RESET 
DO ..\..\..\common\5644Avle.cmm 
DATA.LOAD.ELF &elf /GLOBTYPES /GT /MW /BUGFIX 
DATA.LIST 
WAIT 1s
BREAK.RESET
;BREAK.SET SetPLL
GO
WAIT !run() 10.s
BREAK
DO ..\log.cmm &SC &log

