;**************************************************************************************
; 
;  Freescale(TM) and the Freescale logo are trademarks of Freescale Semiconductor, Inc. 
;  All other product or service names are the property of their respective owners. 
;  (C) Freescale Semiconductor, Inc. 2008 - 2010
; 
;  You can use this example for any purpose on any computer system with the
;  following restrictions:
;
;  1. This example is provided "as is", without warranty.
;
;  2. You don't remove this copyright notice from this example or any direct derivation 
;     thereof.
;
;  Description:  Common part of Lauterbach script for each memory benchmark
;
;**************************************************************************************

GLOBAL &def_suff
LOCAL &tname  &cname
ENTRY &tname &cname

&suff="_gh"

IF ("&def_suff"!="")
    &suff="&def_suff"

TITLE "Memory benchmark for " &tname " " &cname
RESET 
DO ..\..\..\common\5644Avle.cmm 

DATA.LOAD.ELF bin/m&tname&cname&suff.elf /GLOBTYPES /GT /MW /BUGFIX 
DATA.LIST 
WAIT 1s
BREAK.RESET
BREAK.SET EndMeasurement
GO
WAIT !run() 10.s
DO ..\..\common\log.cmm &tname &cname &suff

