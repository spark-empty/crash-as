## com/as.application/board.any/Kconfig
```kconfig
config ANY
    string
    option env="ANY"
    default "none"

source "$ASROOT/com/as.application/board.any/$ANY/Kconfig"
```

## com/as.application/board.any/mpc563xm_nxp_autosar/Kconfig
```kconfig
config ARCH_ANY
    bool
    default y
    select DEFAULT_ASKAR

config ARCH
    string
    default "none"

choice
    prompt "CHIP"
    default MPC5634M_MLQB80

config MPC5632M
    bool "MPC5632M"

config MPC5633M
    bool "MPC5633M"

config MPC5634M_MLQB80
    bool "MPC5634M_MLQB80"

config MPC5634M_MLQC80
    bool "MPC5634M_MLQC80"

endchoice
```

## com/as.application/board.at91sam3s/Kconfig
```kconfig
config ARCH_AT91SAM3S
    bool
    default y
    select DEFAULT_TOPPERS_OSEK

config ARCH
    string
    default "at91sam3s"

config DEMO_LED_APP
	bool "demo led application"
	default y

config USB_SERIAL
	bool "demo USB on serial application"
	default y
	depends on USB
	select RINGBUFFER
```

## com/as.application/board.lm3s6965evb/Kconfig
```kconfig
config ARCH_LM3S6965EVB
    bool
    default y
    select DEFAULT_ASKAR

config ARCH
    string
    default "lm3s"
```

## com/as.application/board.posix/Kconfig
```kconfig
config ARCH_POSIX
    bool
    default y
    select DEFAULT_TINYOS

config ARCH
    string
    default "posix"
```

## com/as.application/board.s3c2440a/Kconfig
```kconfig
config ARCH_S3C2440A
    bool
    default y
    select DEFAULT_TRAMPOLINE

config ARCH
    string
    default "s3c2440a"
```

## com/as.application/board.stm32f107vc/Kconfig
```kconfig
config ARCH_STM31F1
    bool
    default y
    select DEFAULT_ASKAR

config DEMO_LED_APP
	bool "demo led application"
	default y
	depends on DIO

config ARCH
    string
    default "stm32f1"

config USB_SERIAL
	bool "demo USB on serial application"
	default y
	depends on USB
```

## com/as.application/board.versatilepb/Kconfig
```kconfig
config ARCH_VERSATILEPB
    bool
    default y
    select DEFAULT_ASKAR

config ARCH
    string
    default "versatilepb"
```

## com/as.application/board.virt/Kconfig
```kconfig
config ARCH_VIRT
    bool
    default y
    select DEFAULT_ASKAR

config ARCH
    string
    default "virt"
```

## com/as.application/board.x86/Kconfig
```kconfig
config ARCH_X86
    bool
    default y
    select CLIB_NEWLIB
    select DEFAULT_ASKAR

config ARCH
    string
    default "x86"
```

## com/as.infrastructure/Kconfig
```kconfig
source "$ASROOT/com/as.infrastructure/arch/Kconfig"
source "$ASROOT/com/as.infrastructure/communication/Kconfig"
source "$ASROOT/com/as.infrastructure/diagnostic/Kconfig"
source "$ASROOT/com/as.infrastructure/memory/Kconfig"
source "$ASROOT/com/as.infrastructure/system/Kconfig"
source "$ASROOT/com/as.infrastructure/clib/Kconfig"
source "$ASROOT/com/as.infrastructure/libraries/Kconfig"
```

## com/as.infrastructure/arch/at91sam3s/Kconfig
```kconfig
if ARCH_AT91SAM3S
menu "AUTOSAR MCAL&CDD for arch AT91SAM3S"

config MCU
	bool "MCAL MCU driver"
	default y

config USB_DRV
	bool "USB driver"
	default y
	select USB

config USB
	bool "USB core"
	default y

endmenu
endif
```

## com/as.infrastructure/arch/lm3s/Kconfig
```kconfig
menu "AUTOSAR MCAL&CDD for arch lm3s"


config CAN
	bool "MCAL CAN driver"
	default y

config MCU
	bool "MCAL MCU driver"
	default y

endmenu
```

## com/as.infrastructure/arch/none/Kconfig
```kconfig
if ARCH_ANY
menu "AUTOSAR MCAL&CDD for arch ANY"

config CAN
	bool "MCAL CAN driver"
	default n

config LIN
	bool "MCAL LIN driver"
	default n

config SPI
	bool "MCAL SPI driver"
	default n

config DIO
	bool "MCAL DIO driver"
	default n

config MCU
	bool "MCAL MCU driver"
	default y

config WDG
	bool "MCAL Watch Dog driver"
	default n

config PORT
	bool "MCAL PORT driver"
	default n

config ADC
	bool "MCAL ADC driver"
	default n

config ICU
	bool "MCAL ICU driver"
	default n

config PWM
	bool "MCAL PWM driver"
	default n

config GPT
	bool "MCAL GPT driver"
	default n

config FLS
	bool "MCAL FLS driver"
	default n

config FLASH
	bool "HIS FLASH driver"
	default n

endmenu
endif
```

## com/as.infrastructure/arch/s3c2440a/Kconfig
```kconfig
if ARCH_S3C2440A
menu "AUTOSAR MCAL&CDD for arch s3c2440a"

config CAN
	bool "MCAL CAN driver on Serial"
	default y

config LCD
	bool "LCD driver"
	default y

config MCU
	bool "MCAL MCU driver"
	default y

endmenu
endif
```

## com/as.infrastructure/arch/stm32f1/Kconfig
```kconfig
if ARCH_STM31F1
menu "AUTOSAR MCAL&CDD for arch STM32F1"

config CAN
	bool "MCAL CAN driver"
	default y

config SCAN
	bool "MCAL CAN driver on UART"
	default n

config DIO
	bool "MCAL DIO driver"
	default y

config MCU
	bool "MCAL MCU driver"
	default y

config PORT
	bool "MCAL PORT driver"
	default y

config LWIP_DRV
	bool "LWIP driver"
	default y

config USB_DRV
	bool "USB driver"
	default y
	select USB

config USB
	bool "USB core"
	default y

endmenu
endif
```

## com/as.infrastructure/arch/versatilepb/Kconfig
```kconfig
if ARCH_VERSATILEPB
menu "AUTOSAR MCAL&CDD for arch versatilepb"

config PCI
	bool "PCI driver"
	default y
	select CLIB_ASHEAP

config CAN
	bool "MCAL CAN driver"
	depends on PCI
	default y

config FATFS_DRV
	bool "FATFS diskio driver"
	depends on PCI
	default y

config LWEXT4_DRV
	bool "LWEXT4 blockdev driver"
	depends on PCI
	default y

config EEP
	bool "MCAL EEP driver"
	depends on (FATFS || LWEXT4)
	default y

config FLS
	bool "MCAL FLS driver"
	depends on (FATFS || LWEXT4)
	default y

config LCD
	bool "LCD driver"
	default y

config MCU
	bool "MCAL MCU driver"
	default y

choice
	prompt "ethernet driver"
	default LWIP_DRV

config LWIP_DRV
	bool "LWIP driver"
	depends on PCI

config UIP_DRV
	bool "micro IP driver from contiki"
	depends on PCI

config NO_ETH_DRV
	   bool "disabled"

endchoice

endmenu
endif
```

## com/as.infrastructure/arch/virt/Kconfig
```kconfig
menu "AUTOSAR MCAL&CDD for arch virt"

config PCI
	bool "PCI driver"
	default y
	select CLIB_ASHEAP

config CAN
	bool "MCAL CAN driver"
	depends on PCI
	default y

config FATFS_DRV
	bool "FATFS diskio driver"
	depends on PCI
	default y

config LWEXT4_DRV
	bool "LWEXT4 blockdev driver"
	depends on PCI
	default n

config EEP
	bool "MCAL EEP driver"
	depends on (FATFS || LWEXT4)
	default y

config FLS
	bool "MCAL FLS driver"
	depends on (FATFS || LWEXT4)
	default y

config MCU
	bool "MCAL MCU driver"
	default y

config LWIP_DRV
	bool "LWIP driver"
	depends on PCI
	default y

endmenu
```

## com/as.infrastructure/clib/Kconfig
```kconfig
menu "C Library"

config CLIB_ASHEAP
	bool "Memory Heap malloc/free..."
	default n

config CLIB_MBOX
	bool "Message Box"
	select CLIB_ASHEAP
	default y

config CLIB_MISCLIB
	bool "Miscellaneous C Library"
	default y

config CLIB_QSORT
	bool "Queue Sort"
	default y

config CLIB_STDIO_PRINTF
	bool "stdio printf related"
	default y

config CLIB_STDIO_CAN
	bool "stdio on CAN"
	depends on CAN
	default y

config CLIB_STRTOK_R
	bool "string strtok_r related"
	default y

config CLIB_NEWLIB
	bool "Newlib: a C library intended for use on embedded systems"
	default n

if CLIB_NEWLIB
config _SYS__PTHREADTYPES_H_
	int
	default 1
endif

endmenu
```

## com/as.infrastructure/diagnostic/Kconfig
```kconfig
menu "AUTOSAR Diagnostic Stack"

config DCM
	bool "Diagnostic Communication Manager"
	depends on PDUR
	default y

config DEM
	bool "Diagnostic Event Manager"
	depends on NVM
	default y

config DET
	bool "Development Error Trace"
	default y

endmenu
```

## com/as.infrastructure/libraries/Kconfig
```kconfig
menu "libraries"

config IFX
	bool "Interpolation Fixed point"
	default y

config FDT
	bool "flat device tree library"
	default y

config TRACE
	bool "enable the trace library"
	default y

endmenu
```

## com/as.infrastructure/memory/Kconfig
```kconfig
menu "AUTOSAR Memory Stack"
config EA
	bool "EEPROM Abstraction Layer"
	depends on EEP
	default y

config FEE
	bool "Flash EEPROM Emulation"
	depends on FLS
	default y

config MEMIF
	bool "Memory Abstraction Interface"
	depends on (EA || FEE)
	default y

config NVM
	bool "NVRAM Manager"
	depends on MEMIF
	select CLIB_MBOX
	default y

endmenu
```

## com/as.infrastructure/system/fs/Kconfig
```kconfig
menu "File System"
config FATFS
	bool "FATFS File System"
	depends on FATFS_DRV
	default y

config LWEXT4
	bool "LWEXT4 File System"
	depends on LWEXT4_DRV
	default y

config VFS
	bool "Virtual File System"
	depends on (FATFS || LWEXT4)
	default y

config LIBELF
	bool "Library for manipulating ELF files"
	depends on VFS && !ARCH_POSIX
	default y

config LIBDL
	bool "programming interface to dynamic linking loader"
	depends on LIBELF
	default y

endmenu
```

## com/as.infrastructure/system/kernel/Kconfig
```kconfig
menu "Operating System"

config DEFAULT_ASKAR
	bool

config DEFAULT_TINYOS
	bool

config DEFAULT_RTTHREAD
	bool

config DEFAULT_ATK2_SC4
	bool

config DEFAULT_TRAMPOLINE
	bool

config DEFAULT_TOPPERS_OSEK
	bool

config DEFAULT_FREERTOS
	bool

config DEFAULT_MINIX
	bool

config DEFAULT_CONTIKI
	bool

choice
	prompt "RTOS"
	default ASKAR if DEFAULT_ASKAR
	default TINYOS if DEFAULT_TINYOS
	default RTTHREAD if DEFAULT_RTTHREAD
	default ATK2_SC4 if DEFAULT_ATK2_SC4
	default TRAMPOLINE if DEFAULT_TRAMPOLINE
	default TOPPERS_OSEK if DEFAULT_TOPPERS_OSEK
	default FREERTOS if DEFAULT_FREERTOS
	default CONTIKI if DEFAULT_CONTIKI
	default MINIX if DEFAULT_MINIX

config ASKAR
	bool "askar:Automotive oSeK AutosaR/pthreads RTOS"

config TINYOS
	bool "tiny OSEK BCC1 RTOS"

config RTTHREAD
	bool "rt-thread"

config ATK2_SC4
	bool "ask-sc4"

config TRAMPOLINE
	bool "trampoline"

config TOPPERS_OSEK
	bool "toppers osek"

config FREERTOS
	bool "freertos"

config CONTIKI
	bool "Contiki: The Open Source OS for the Internet of Things"

config MINIX
	bool "minix 3.0: internal study purpose"

config ANYOS
	bool "any other 3rd party OS under board.any"

endchoice

config PROTOTHREAD
	bool "protothread(or named coroutine)"
	default y if !ARCH_POSIX

if ASKAR
source "$ASROOT/com/as.infrastructure/system/kernel/askar/Kconfig"
endif

endmenu
```
